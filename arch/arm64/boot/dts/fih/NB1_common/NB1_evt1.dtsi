/* Copyright (c) 2013, The Linux Foundation. All rights reserved.
 *
 * This program is free software; you can redistribute it and/or modify
 * it under the terms of the GNU General Public License version 2 and
 * only version 2 as published by the Free Software Foundation.
 *
 * This program is distributed in the hope that it will be useful,
 * but WITHOUT ANY WARRANTY; without even the implied warranty of
 * MERCHANTABILITY or FITNESS FOR A PARTICULAR PURPOSE.  See the
 * GNU General Public License for more details.
 */

/* Power */
#include "fih_power.dtsi"
/* Memory */
#include "fih_memmap_nb1_evb.dtsi"

/* Thermal */
#include "fih_thermal.dtsi"

/*PIN ctrl*/
#include "msm8998-pinctrl-NB1.dtsi"

/* Display */
#include "Display-nt36850.dtsi"
/* Touch Panel */
#include "touch_synaptics.dtsi"
#include "touch_lg4946.dtsi"

/* Camera */
#include "camera-evt0.dtsi"

/* Audio */
#include "audio-alsa-evt0.dtsi"
/* Peripherals */

/* Wireless */

/* Sensor */
#include "rangefinder-stmvl53l0-cci-evt1.dtsi"

/* LEDS */
#include "rgb.dtsi"
#include "hall.dtsi"
#include "keypad.dtsi"
#include "vibrator.dtsi"

/* USB */
#include "NB1_usb.dtsi"

/* FINGERPRINT */
/*KC Add for GOODIX fingerprint */
#include "pinctrl-msm8998-evt_goodix.dtsi"
#include "FP_Goodix_TEE_V0.dtsi"
/* KC Add for external LDO control */
#include "fixed-regulator-EVT-v1.dtsi"

/* NFC, NXP PN547 */
#include "nfc-nxp-pn547-evt1.dtsi"
