/* Copyright (c) 2013, The Linux Foundation. All rights reserved.
 *
 * This program is free software; you can redistribute it and/or modify
 * it under the terms of the GNU General Public License version 2 and
 * only version 2 as published by the Free Software Foundation.
 *
 * This program is distributed in the hope that it will be useful,
 * but WITHOUT ANY WARRANTY; without even the implied warranty of
 * MERCHANTABILITY or FITNESS FOR A PARTICULAR PURPOSE.  See the
 * GNU General Public License for more details.
 */

/* Power */
#include "fih_power.dtsi"
/* Memory */
#include "fih_memmap_nb1_evb.dtsi"

/* Thermal */
#include "fih_thermal.dtsi"

/*PIN ctrl*/
#include "msm8998-pinctrl-NB1.dtsi"

/* Display */
#include "Display-nt36850.dtsi"
/* Touch Panel */
#include "touch_synaptics.dtsi"
#include "touch_lg4946.dtsi"

/* Camera */
#include "camera-evt0.dtsi"

/* Audio */
#include "audio-alsa-dvt.dtsi"
/* Peripherals */

/* Wireless */

/* Sensor */
#include "rangefinder-stmvl53l0-cci-evt1.dtsi"

/* LEDS */
#include "rgb.dtsi"
#include "hall.dtsi"
#include "keypad.dtsi"
#include "vibrator.dtsi"

/* USB */
#include "NB1_usb_pvt1.dtsi"

/* FINGERPRINT */
/*KC Add for GOODIX fingerprint */
#include "pinctrl-msm8998-evt_goodix.dtsi"
#include "FP_Goodix_TEE_V0.dtsi"
/* KC Add for external LDO control */
#include "fixed-regulator-EVT-v1.dtsi"

&pm8998_gpios {
	/* GPIO_14 - DIV_CLK2 */
	gpio@cd00 {
		reg = <0xcd00 0x100>;
		qcom,pin-num = <14>;
		status = "okay";
		qcom,mode = <1>; /* QPNP_PIN_MODE_DIG_OUT */
		qcom,output-type = <0>; /* QPNP_PIN_OUT_BUF_CMOS */
		qcom,pull = <5>; /* QPNP_PIN_PULL_NO */
		qcom,vin-sel = <0>; /* QPNP_PIN_VIN0 */
		qcom,out-strength = <3>; /* QPNP_PIN_OUT_STRENGTH_HIGH */
		qcom,src-sel = <2>; /* QPNP_PIN_SEL_FUNC_1 */
		qcom,master-en = <1>;
	};
};

